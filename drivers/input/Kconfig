## drivers/input/Kconfig
```kconfig
# Copyright 2024 Google LLC
# SPDX-License-Identifier: Apache-2.0

menuconfig INPUT_PMW3610
	bool "PMW3610 low power laser mouse sensor input driver"
	default y
	depends on GPIO
	depends on SPI
	depends on INPUT
	depends on DT_HAS_PIXART_PMW3610_ENABLED
	help
	  PMW3610 low power laser mouse sensor input driver
```
